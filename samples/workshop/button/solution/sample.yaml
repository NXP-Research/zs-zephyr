## samples/workshop/button/solution/sample.yaml
```yaml
sample:
  name: Workshop Button + LED (solution)
  description: Toggle an LED from a button interrupt
common:
  tags:
    - workshop
    - gpio
  platform_allow:
    - frdm_mcxa156
  integration_platforms:
    - frdm_mcxa156
  depends_on: gpio
  build_only: true
tests:
  sample.workshop.button.solution: {}
```

## samples/workshop/reaction_game/solution/sample.yaml
```yaml
sample:
  name: Workshop Reaction Game (solution)
  description: Measure the reaction time to an LED
common:
  tags:
    - workshop
    - gpio
  platform_allow:
    - frdm_mcxa156
  integration_platforms:
    - frdm_mcxa156
  depends_on: gpio
  build_only: true
tests:
  sample.workshop.reaction_game.solution: {}
```

## samples/workshop/threads/sample.yaml
```yaml
sample:
  name: Workshop Threads
  description: Starter code for the workshop exercise
common:
  tags:
    - workshop
    - gpio
  platform_allow:
    - frdm_mcxa156
  integration_platforms:
    - frdm_mcxa156
  depends_on: gpio
  build_only: true
tests:
  sample.workshop.threads: {}
```

## samples/workshop/threads/solution/sample.yaml
```yaml
sample:
  name: Workshop Threads (solution)
  description: ISR, message queue and worker thread
common:
  tags:
    - workshop
    - gpio
  platform_allow:
    - frdm_mcxa156
  integration_platforms:
    - frdm_mcxa156
  depends_on: gpio
  build_only: true
tests:
  sample.workshop.threads.solution: {}
```
